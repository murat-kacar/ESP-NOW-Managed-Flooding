## apps/apartment/main/Kconfig.projbuild
```kconfig
menu "Doorbell apartment module"

    menu "GPIO"
        comment "ESP32: GPIO 6-11 are used by flash; GPIO 34-39 are input-only without pull-ups."

        config DB_BELL_RELAY_GPIO
            int "Bell relay"
            range 0 33
            default 4
        config DB_BELL_RELAY_ACTIVE_HIGH
            bool "Bell relay is driven HIGH to ring"
            default y
            help
                SPEC 2.2.
        config DB_DOOR_BUTTON_GPIO
            int "Door-open button"
            range 0 33
            default 23
        config DB_PAIRING_BUTTON_GPIO
            int "Hidden pairing button"
            range 0 33
            default 18
        config DB_RESET_BUTTON_GPIO
            int "Hidden reset button"
            range 0 33
            default 19
        config DB_BUTTONS_ACTIVE_LOW
            bool "Buttons pull the GPIO LOW when pressed"
            default y
            help
                SPEC 2.2: buttons connect to GND.
        config DB_BUTTONS_PULLUP
            bool "Enable the internal pull resistors on the buttons"
            default y
            help
                espressif/button picks pull-up for active-LOW buttons and pull-down for active-HIGH ones.
        config DB_STATUS_LED_GPIO
            int "Status LED"
            range 0 33
            default 2
    endmenu

    menu "Bell"
        config DB_BELL_PULSE_MS
            int "Bell relay pulse (ms)"
            range 100 5000
            default 500
        config DB_VISUAL_BELL
            bool "Blink the status LED while ringing"
            default y
            help
                Visual bell for hearing-impaired residents (SPEC 11.2).
    endmenu

    menu "Buttons"
        config DB_DOOR_BUTTON_MIN_MS
            int "Door button minimum press (ms)"
            range 10 1000
            default 100
            help
                Shorter presses are ignored as noise.
        config DB_DOOR_BUTTON_MAX_S
            int "Door button maximum press (s)"
            range 1 120
            default 30
            help
                Longer presses are ignored as a stuck button.
        config DB_SERVICE_HOLD_MIN_S
            int "Pairing/reset button minimum hold (s)"
            range 1 30
            default 7
        config DB_SERVICE_HOLD_MAX_S
            int "Pairing/reset button maximum hold (s)"
            range 2 60
            default 12
        config DB_SERVICE_HOLD_CANCEL_S
            int "Pairing/reset button cancel after (s)"
            range 3 65
            default 15
            help
                Upper limit 65 s: espressif/button long-press thresholds are 16-bit milliseconds.
                Must be greater than the maximum hold.
    endmenu

    config DB_OPEN_DOOR_RETRIES
        int "OPEN_DOOR retries without ACK"
        range 0 10
        default 1
        help
            SPEC 7.4.

endmenu
```

## apps/panel/main/Kconfig.projbuild
```kconfig
menu "Doorbell panel"

    menu "GPIO"
        comment "ESP32: GPIO 6-11 are used by flash; GPIO 34-39 are input-only without pull-ups."

        config DB_KEYPAD_ROW0_GPIO
            int "Keypad row 0"
            range 0 33
            default 13
        config DB_KEYPAD_ROW1_GPIO
            int "Keypad row 1"
            range 0 33
            default 14
        config DB_KEYPAD_ROW2_GPIO
            int "Keypad row 2"
            range 0 33
            default 27
        config DB_KEYPAD_ROW3_GPIO
            int "Keypad row 3"
            range 0 33
            default 26
        config DB_KEYPAD_COL0_GPIO
            int "Keypad column 0"
            range 0 33
            default 25
        config DB_KEYPAD_COL1_GPIO
            int "Keypad column 1"
            range 0 33
            default 33
        config DB_KEYPAD_COL2_GPIO
            int "Keypad column 2"
            range 0 33
            default 32
        config DB_DOOR_RELAY_GPIO
            int "Door relay"
            range 0 33
            default 23
        config DB_DOOR_RELAY_ACTIVE_LOW
            bool "Door relay is driven LOW to open"
            default y
            help
                Active-LOW optocoupled relay module (ADR 0005).
        config DB_BUZZER_GPIO
            int "Buzzer"
            range 0 33
            default 4
        config DB_STATUS_LED_GPIO
            int "Status LED"
            range 0 33
            default 2
        config DB_CODE_RESET_BUTTON_GPIO
            int "Hidden code reset button"
            range 0 33
            default 19
        config DB_CODE_RESET_BUTTON_ACTIVE_LOW
            bool "Code reset button pulls the GPIO LOW when pressed"
            default y
        config DB_CODE_RESET_BUTTON_PULLUP
            bool "Enable the internal pull resistor on the code reset button"
            default y
            help
                espressif/button picks pull-up for an active-LOW button and pull-down for an active-HIGH one.
    endmenu

    menu "Keypad"
        config DB_KEYPAD_KEYMAP
            string "Key map (rows top to bottom, columns left to right)"
            default "123456789*0#"
            help
                12 characters for the 3x4 matrix. Default is the ITU-T E.161 telephone keypad layout.
        comment "Debounce and scan period: IoT Button menu (espressif/button), added with the keypad driver."
        config DB_KEYPAD_INPUT_TIMEOUT_S
            int "Input timeout (s)"
            range 3 60
            default 10
    endmenu

    menu "Door and buzzer"
        config DB_DOOR_PULSE_MS
            int "Door relay pulse (ms)"
            range 100 5000
            default 500
            help
                ADR 0005.
        config DB_BUZZER_DURATION_MS
            int "Buzzer duration (ms)"
            range 0 5000
            default 500
            help
                ADR 0005 starts the buzzer with the relay for the same 0.5 s.
        config DB_BUZZER_FREQUENCY_HZ
            int "Buzzer tone frequency (Hz)"
            range 100 10000
            default 2700
            help
                Set from the passive buzzer's datasheet (resonant frequency). Proposed value, not verified.
        config DB_BUZZER_DUTY_PCT
            int "Buzzer PWM duty (%)"
            range 1 99
            default 50
            help
                50 % is a square wave.
    endmenu

    menu "Apartments and codes"
        config DB_APARTMENT_MIN
            int "Lowest apartment number"
            range 1 254
            default 1
        config DB_APARTMENT_MAX
            int "Highest apartment number"
            range 1 254
            default 99
            help
                SPEC 3.1. The message field is 8 bits.
        config DB_ADMIN_CODE_LENGTH
            int "Admin code length (digits)"
            range 6 10
            default 6
            help
                Minimum 6 to keep brute-force resistance (SPEC 4).
        config DB_USER_CODE_LENGTH
            int "User code length (digits)"
            range 4 8
            default 4
    endmenu

    menu "Keypad lockout"
        config DB_LOCKOUT_ATTEMPTS
            int "Wrong codes before lockout"
            range 1 20
            default 5
        config DB_LOCKOUT_BASE_S
            int "First lockout (s)"
            range 10 3600
            default 60
        config DB_LOCKOUT_MULTIPLIER
            int "Lockout multiplier on each further failure"
            range 1 10
            default 2
            help
                SPEC 4.1: the lockout doubles (120, 240 s, ...).
        config DB_LOCKOUT_MAX_S
            int "Maximum lockout (s)"
            range 60 86400
            default 900
    endmenu

    menu "Code reset button"
        config DB_CODE_RESET_HOLD_MIN_S
            int "Minimum hold (s)"
            range 1 60
            default 10
        config DB_CODE_RESET_HOLD_MAX_S
            int "Maximum hold (s)"
            range 10 300
            default 60
    endmenu

    config DB_RING_RETRIES
        int "RING retries without ACK"
        range 0 10
        default 2
        help
            SPEC 7.4.

endmenu
```

## components/db_net/Kconfig
```kconfig
menu "Doorbell network"

    choice DB_TX_POWER
        prompt "Maximum TX power"
        default DB_TX_POWER_20DBM
        help
            Maximum Wi-Fi TX power (SPEC 7.6). 20 dBm is the ESP-IDF default maximum.

        config DB_TX_POWER_10DBM
            bool "10 dBm (lab bench)"
            help
                Sets 40 (0.25 dBm units, SPEC 7.6); ESP-IDF maps it to 34 = 8.5 dBm (esp_wifi_set_max_tx_power).
        config DB_TX_POWER_20DBM
            bool "20 dBm (field)"
    endchoice

    config DB_FORWARD_TTL
        int "Forward TTL (hops)"
        range 1 30
        default 10
        help
            Maximum number of hops (frame_head.forward_ttl). Default from esp-now
            ESPNOW_CONTROL_FORWARD_TTL. 31 means unlimited in esp-now and is not allowed.
            Not verified by field measurement yet (SPEC 9).

    config DB_FORWARD_RSSI_FILTER
        bool "Forward only packets received above an RSSI threshold"
        default n
        help
            Off: every module forwards every new message once, whatever its signal strength, as the relay nodes of
            BLE Mesh managed flooding do; the TTL and the esp-now message cache bound the traffic (ADR 0019).
            On: a module forwards only packets received at or above the threshold below
            (frame_head.forward_rssi, esp-now default -55 dBm).

    config DB_FORWARD_RSSI
        int "Forward RSSI threshold (dBm)"
        depends on DB_FORWARD_RSSI_FILTER
        range -70 -30
        default -70
        help
            Packets received weaker than this are not forwarded (frame_head.forward_rssi). Range from esp-now
            ESPNOW_CONTROL_FORWARD_RSSI; default -70, the lowest value, instead of the esp-now default -55, at which
            the range in the building test was too low (2026-11-06). To be set from the building's measured RSSI
            (SPEC 9).

    config DB_RETRANSMIT_COUNT
        int "Retransmit count"
        range 0 31
        default 10
        help
            Radio retransmissions per packet (frame_head.retransmit_count, 5-bit field).
            Default from esp-now ESPNOW_FRAME_CONFIG_DEFAULT.

    config DB_ACK_TIMEOUT_MS
        int "Application ACK timeout (ms)"
        range 50 5000
        default 400
        help
            Time to wait for RING_ACK / OPEN_DOOR_ACK (SPEC 7.4). esp-now has no default for
            end-to-end ACKs; 400 ms is the original specification value. Not verified yet (SPEC 9).

    config DB_PAIRING_WINDOW_S
        int "Pairing window (s)"
        range 10 120
        default 20
        help
            How long the panel scans and the unpaired module waits during pairing (SPEC 5.1).

    config DB_FILTER_WEAK_SIGNAL
        bool "Drop packets weaker than the forward RSSI threshold"
        depends on DB_FORWARD_RSSI_FILTER
        default n
        help
            frame_head.filter_weak_signal. Off in esp-now ESPNOW_FRAME_CONFIG_DEFAULT.

    config DB_REPLAY_COUNTER_BLOCK
        int "Replay counter NVS block size"
        range 1 10000
        default 100
        help
            The counter is persisted once per block of messages to limit flash wear (ADR 0002).
            To be set from usage data; proposed value, not verified (SPEC 9).

    config DB_HEARTBEAT
        bool "Module health reports (heartbeat)"
        default y
        help
            Each paired module reports its uptime, last reset reason and fault counters to the panel, and the panel
            logs a module that stays silent for 3 intervals (ADR 0015). Set the same value on both roles.

    config DB_HEARTBEAT_INTERVAL_S
        int "Heartbeat interval (s)"
        depends on DB_HEARTBEAT
        range 10 86400
        default 3600
        help
            Time between two reports of one module, with +/-10 % random jitter. Report traffic grows with the
            square of the module count (ADR 0015): about 27 frames/s for 99 modules at 3600 s. Use short intervals,
            for example 30 s, only for bench tests with a few modules. Set the same value on both roles.

    menu "Wi-Fi channel"
        comment "Candidate channels for the installation site scan (ADR 0006)."

        config DB_CHANNEL_DWELL_MS
            int "Pairing channel dwell time (ms)"
            range 100 5000
            default 500
            help
                Time the unpaired module waits on each candidate channel for the panel's HELLO_ACK (ADR 0012).
                After the first HELLO the panel listens for one full module cycle (3 x dwell) to notice a second
                module, so 6 x dwell must stay well below the pairing window.
                No official default exists; proposed value, not verified by bench test (SPEC 9).

        config DB_CHANNEL_CANDIDATE_1
            int "Candidate channel 1"
            range 1 13
            default 1
        config DB_CHANNEL_CANDIDATE_2
            int "Candidate channel 2"
            range 1 13
            default 6
        config DB_CHANNEL_CANDIDATE_3
            int "Candidate channel 3"
            range 1 13
            default 11
    endmenu

    menu "Wi-Fi regulatory and PHY"
        config DB_WIFI_COUNTRY_OVERRIDE
            bool "Set a Wi-Fi country code"
            default n
            help
                Off keeps the ESP-IDF default country setting. The country limits usable channels and TX power.
        config DB_WIFI_COUNTRY_CODE
            string "Country code (ISO 3166-1 alpha-2)"
            depends on DB_WIFI_COUNTRY_OVERRIDE
            default ""
        config DB_WIFI_LONG_RANGE
            bool "Enable ESP-NOW Long Range mode"
            default y
            help
                Espressif Long Range (LR) PHY: about 4 dB better reception sensitivity than 802.11b, in theory 2 to
                2.5 times the distance (ESP-IDF Wi-Fi driver guide). Adds LR to the radio protocols, as the ESP-IDF
                espnow example does, and sends every message at the LR rate below (esp_now_set_peer_rate_config on
                the broadcast peer). 802.11b/g/n stay enabled, so the panel's site scan still sees access points.
                Every device must use the same setting. An LR frame stays 2 to 4 times longer on air than at the
                default 1 Mbit/s: consider a lower retransmit count with it (ADR 0019). On by default (owner's
                decision 2026-11-06, for the range between floors); effect to be measured in the field.

        choice DB_WIFI_LR_RATE
            prompt "Long Range rate"
            depends on DB_WIFI_LONG_RANGE
            default DB_WIFI_LR_RATE_250K
            help
                250 kbit/s has the best sensitivity; 500 kbit/s halves the time on air.

            config DB_WIFI_LR_RATE_250K
                bool "250 kbit/s (longest range)"
            config DB_WIFI_LR_RATE_500K
                bool "500 kbit/s"
        endchoice
    endmenu

endmenu
```
